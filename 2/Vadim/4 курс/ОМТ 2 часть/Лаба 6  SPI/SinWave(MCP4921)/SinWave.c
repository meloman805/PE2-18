/*******************************************************
Chip type               : ATmega328P
AVR Core Clock frequency: 16,000000 MHz
*******************************************************/
#include <mega328p.h>
#include <delay.h>

// Declare your global variables here
flash unsigned int samples[512]=              //таблица синуса с 512 отсчетами
{
  2048, 2073, 2098, 2123, 2148, 2174, 2199, 2224,
  2249, 2274, 2299, 2324, 2349, 2373, 2398, 2423,
  2448, 2472, 2497, 2521, 2546, 2570, 2594, 2618,
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  1847, 1872, 1897, 1922, 1948, 1973, 1998, 2023
};

//flash unsigned int samples[32] =                    //таблица синуса с 32 отсчётами
//{
//  2048, 2447, 2831, 3185, 3495, 3750, 3939, 4056,
//  4095, 4056, 3939, 3750, 3495, 3185, 2831, 2447,
//  2048, 1648, 1264,  910,  600,  345,  156,   39,
//     0,   39,  156,  345,  600,  910, 1264, 1648
//};
// SPI functions
//#include <spi.h>
//Определение линий портов для SPI МК Atmega328p
#define SS PORTB2
#define SCK PORTB5
#define MOSI PORTB3
//Определение разрядов старшего байта передаваемого в ЦАП слова
#define AB 7    // Для MCP4921 должен быть 0
#define BUF 6   // 1 - есть буферизация Vref, 0 - нет буферизации Vref
#define GA 5    // 1 - GAIN=1, 0 - GAIN=0
#define SHDN 4  // 1 - выходы ЦАП включены, 0 - выходы в высокоимпедансном состоянии

/*ФУНКЦИЯ ПЕРЕДАЧИ БАЙТА ПО SPI-ИНТЕРФЕЙСУ ОТ MASTER-устройства(МК)*/
void SPI_MasterTransmit(char d) //в переменную d принимаем байт для отправки по SPI интерфейсу
  {
  SPDR = d;                     //передаем байт в сдвиговый регистр SPDR
  while(~SPSR & (1<<SPIF));     //ждем пока появится 1 в разряде SPIF (7) регистра 
                                //SPSR - признак завершения передачи байта
  }                             //байт передан устройству Slave, возврат

/*ФУНКЦИЯ ОТПРАВКИ 16 БИТ ДАННЫХ ПО SPI-ИНТЕРФЕЙСУ - установки напряжения на выходе ЦАП*/
void SET_Voltage(unsigned int cd)
{
PORTB&=~(1<<SS);    //на /SS установить 0 для выбора ведомого устройства (ЦАП)

//Отправляем по SPI (0x1DDD) первые 4 бита(15-12) конфигурационные, 
//остальные данные(11-0) - код для напряжения, которое будет установлено на выходе ЦАП

//Выводим ЦАП из режима SHDN (SHDN=1), устанавливаем Gain=1 
//поскольку переменная cd 16 битная, сдвигаем старшие 8 бит вправо(первыми отправляем старшие 8 бит).
SPI_MasterTransmit((0<<AB)|(0<<BUF)|(1<<GA)|(1<<SHDN)|(cd>>8)); //отправляем старшие(15-8) 8 бит данных:
//4 конфигурационных бита (биты 7-4) и старшую тетраду данных (биты 3-0) 
 
SPI_MasterTransmit(cd);         //Отправляем по SPI младшие(0-7) 8 бит данных
PORTB|=(1<<SS);                 //на /SS установить 1, т.е. отключить ведомое устройство
}

/*ГЛАВНАЯ ФУНКЦИЯ*/
void main(void)
{
unsigned int i, step=4;
// Crystal Oscillator division factor: 1
#pragma optsize-
CLKPR=(1<<CLKPCE);
CLKPR=(0<<CLKPCE) | (0<<CLKPS3) | (0<<CLKPS2) | (0<<CLKPS1) | (0<<CLKPS0);
#ifdef _OPTIMIZE_SIZE_
#pragma optsize+
#endif

/*НАСТРОЙКА ПЕРИФЕРИИ*/
// Input/Output Ports initialization
// Port B initialization
// Function: Bit7=In Bit6=In Bit5=Out Bit4=In Bit3=Out Bit2=Out Bit1=In Bit0=In
// Выходные линии инт. SPI:   PB5-SCK;               PB3-MOSI;    PB2-/SS 
DDRB=(0<<DDB7) | (0<<DDB6) | (1<<DDB5) | (0<<DDB4) | (1<<DDB3) | (1<<DDB2) | (0<<DDB1) | (0<<DDB0);
// State: Bit7=T Bit6=T Bit5=0 Bit4=T Bit3=0 Bit2=0 Bit1=T Bit0=T 
PORTB=(0<<PORTB7) | (0<<PORTB6) | (0<<PORTB5) | (0<<PORTB4) | (0<<PORTB3) | (0<<PORTB2) | (0<<PORTB1) | (0<<PORTB0);

// SPI initialization
// SPI Type: Master
// SPI Clock Rate: 2*4000,000 kHz - максимально возможная скорость передачи по SPI для данного МК
// SPI Clock Phase: Cycle Start
// SPI Clock Polarity: Low
// SPI Data Order: MSB First
SPCR=(0<<SPIE) | (1<<SPE) | (0<<DORD) | (1<<MSTR) | (0<<CPOL) | (0<<CPHA) | (0<<SPR1) | (0<<SPR0);
SPSR=(1<<SPI2X);

while (1)
      {
      // Place your code here
      //ЦИКЛИЧЕСКИЙ ВЫВОД ЗНАЧЕНИЙ МАССИВА СИНУСОВ В ЦАП
      for (i=0;i<512;i=i+step) 
            {
             SET_Voltage(samples[i]);   
            };

      }
}
